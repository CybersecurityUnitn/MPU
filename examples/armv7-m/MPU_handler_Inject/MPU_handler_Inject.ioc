# file: MPU_handler_Inject.ioc
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Mcu.Family=STM32F2
RCC.VCOOutputFreq_Value=192000000
RCC.APB2Freq_Value=16000000
RCC.CortexFreq_Value=16000000
PA14.Mode=Serial_Wire
PB14.GPIO_Label=LED_R
PA13.Mode=Serial_Wire
Mcu.Name=STM32F207Z(C-E-F-G)Tx
RCC.48MHZClocksFreq_Value=48000000
RCC.SYSCLKFreq_VALUE=16000000
Mcu.Package=LQFP144
ProjectManager.StackSize=0x400
PA13.Signal=SYS_JTMS-SWDIO
PA14.Signal=SYS_JTCK-SWCLK
ProjectManager.HeapSize=0x200
ProjectManager.TargetToolchain=STM32CubeIDE
RCC.HSI_VALUE=16000000
NVIC.PriorityGroup=NVIC_PRIORITYGROUP_4
RCC.APB1Freq_Value=16000000
RCC.LSE_VALUE=32768
RCC.AHBFreq_Value=16000000
PB14.Signal=GPIO_Output
RCC.HSE_VALUE=25000000
board=custom

// file: Core/Src/main.c
/* USER CODE BEGIN Header */
/**
  ******************************************************************************
  * @file           : main.c
  * @brief          : Main program body
  * @author         : Michele Grisafi
  ******************************************************************************
  * @attention
  * This code is based on an STMicroelectronics demo application.
  * <h2><center>&copy; Copyright (c) 2021 STMicroelectronics.
  * All rights reserved.</center></h2>
  *
  * This software component is licensed by ST under BSD 3-Clause license,
  * the "License"; You may not use this file except in compliance with the
  * License. You may obtain a copy of the License at:
  *                        opensource.org/licenses/BSD-3-Clause
  *
  ******************************************************************************
  */
/* USER CODE END Header */
#include "main.h"

void SystemClock_Config(void);
static void MX_GPIO_Init(void);

/* USER CODE BEGIN 0 */

void disableMPU(){
	ARM_MPU_Disable();
}

void enableMPU(){
	ARM_MPU_Enable(0x05);
}

void setupMPU(){
	unsigned long executeAccessFlash = ARM_MPU_RASR(0UL,ARM_MPU_AP_URO,1UL,0UL,0UL,0UL,0x00UL,ARM_MPU_REGION_SIZE_1MB) | ARM_MPU_REGION_SIZE_1MB<<1 | 1UL;
	unsigned long noExecAccessRam = ARM_MPU_RASR(1UL,ARM_MPU_AP_FULL,1UL,0UL,0UL,0UL,0x00UL,ARM_MPU_REGION_SIZE_4GB) | ARM_MPU_REGION_SIZE_128KB<<1 | 1UL;
	unsigned long restrictedZone = ARM_MPU_RASR(1UL,ARM_MPU_AP_NONE,1UL,0UL,0UL,0UL,0x00UL,ARM_MPU_REGION_SIZE_32B) | ARM_MPU_REGION_SIZE_32B<<1 | 1UL;

	//ARM_MPU_SetRegionEx(0UL, 0x00000000UL, fullAccessBackground);
	ARM_MPU_SetRegionEx(1UL, 0x08000000UL, executeAccessFlash);
	ARM_MPU_SetRegionEx(2UL, 0x20000000UL, noExecAccessRam);
	ARM_MPU_SetRegionEx(3UL, 0x20004000UL, restrictedZone);

	enableMPU();

}
/* USER CODE END 0 */

int main(void)
{

  /* MCU Configuration--------------------------------------------------------*/

  /* Reset of all peripherals, Initializes the Flash interface and the Systick. */
  HAL_Init();

  /* Configure the system clock */
  SystemClock_Config();

  /* Initialize all configured peripherals */
  MX_GPIO_Init();
  /* USER CODE BEGIN 2 */
  setupMPU();

  //Lower the privileges
  __asm("MOV R0, #01");
  __asm("MSR CONTROL, R0");

  //This instruction triggers an memory fault
  HAL_GPIO_TogglePin(GPIOB, GPIO_PIN_14);
  /* USER CODE END 2 */

  /* Infinite loop */
  while (1)
  {

  }
}

void SystemClock_Config(void)
{
  RCC_OscInitTypeDef RCC_OscInitStruct = {0};
  RCC_ClkInitTypeDef RCC_ClkInitStruct = {0};

  /** Initializes the RCC Oscillators according to the specified parameters
  * in the RCC_OscInitTypeDef structure.
  */
  RCC_OscInitStruct.OscillatorType = RCC_OSCILLATORTYPE_HSI;
  RCC_OscInitStruct.HSIState = RCC_HSI_ON;
  RCC_OscInitStruct.HSICalibrationValue = RCC_HSICALIBRATION_DEFAULT;
  RCC_OscInitStruct.PLL.PLLState = RCC_PLL_NONE;
  if (HAL_RCC_OscConfig(&RCC_OscInitStruct) != HAL_OK)
  {
    Error_Handler();
  }
  /** Initializes the CPU, AHB and APB buses clocks
  */
  RCC_ClkInitStruct.ClockType = RCC_CLOCKTYPE_HCLK|RCC_CLOCKTYPE_SYSCLK
                              |RCC_CLOCKTYPE_PCLK1|RCC_CLOCKTYPE_PCLK2;
  RCC_ClkInitStruct.SYSCLKSource = RCC_SYSCLKSOURCE_HSI;
  RCC_ClkInitStruct.AHBCLKDivider = RCC_SYSCLK_DIV1;
  RCC_ClkInitStruct.APB1CLKDivider = RCC_HCLK_DIV1;
  RCC_ClkInitStruct.APB2CLKDivider = RCC_HCLK_DIV1;

  if (HAL_RCC_ClockConfig(&RCC_ClkInitStruct, FLASH_LATENCY_0) != HAL_OK)
  {
    Error_Handler();
  }
}

static void MX_GPIO_Init(void)
{
  GPIO_InitTypeDef GPIO_InitStruct = {0};

  /* GPIO Ports Clock Enable */
  __HAL_RCC_GPIOB_CLK_ENABLE();
  __HAL_RCC_GPIOA_CLK_ENABLE();

  /*Configure GPIO pin Output Level */
  HAL_GPIO_WritePin(LED_R_GPIO_Port, LED_R_Pin, GPIO_PIN_RESET);

  /*Configure GPIO pin : LED_R_Pin */
  GPIO_InitStruct.Pin = LED_R_Pin;
  GPIO_InitStruct.Mode = GPIO_MODE_OUTPUT_PP;
  GPIO_InitStruct.Pull = GPIO_NOPULL;
  GPIO_InitStruct.Speed = GPIO_SPEED_FREQ_LOW;
  HAL_GPIO_Init(LED_R_GPIO_Port, &GPIO_InitStruct);

}

void Error_Handler(void)
{
  __disable_irq();
  while (1)
  {
  }
}

/************************ (C) COPYRIGHT STMicroelectronics *****END OF FILE****/
